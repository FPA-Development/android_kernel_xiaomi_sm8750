## drivers/input/fingerprint/mi_fp/Kconfig
```kconfig
# SPDX-License-Identifier: GPL-2.0-only

config FINGERPRINT_MI_FP
	tristate "Xiaomi fingerprint sensor driver"
	depends on DRM && NET && OF && QCOM_PANEL_EVENT_NOTIFIER
	help
	  Platform driver for the fingerprint sensors on Xiaomi phones. It
	  handles the sensor power, reset and interrupt lines and, for the
	  Qualcomm ultrasonic sensors, the finger detect and IPC interrupts
	  the fingerprint HAL and trusted application rely on.

	  To compile this driver as a module, choose M here: the module will
	  be called mi_fp.

config ULTRA_FINGERPRINT_P11
	bool "Xiaomi P11 (annibale) ultrasonic fingerprint variant"
	depends on FINGERPRINT_MI_FP
	default n
	help
	  Enable the Qualcomm ultrasonic fingerprint configuration used on
	  Xiaomi P11 (annibale), where finger detection is handled over the
	  touch IC (TIC) via intr2-side-config rather than a WUHB GPIO.
```
